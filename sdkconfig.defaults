## sdkconfig.defaults
```kconfig
# target
CONFIG_IDF_TARGET="esp32"

# freertos
CONFIG_FREERTOS_HZ=1000

# logging
CONFIG_LOG_DEFAULT_LEVEL_INFO=y

# bluetooth (disabled for smoke test, enable later)
# CONFIG_BT_ENABLED=y
# CONFIG_BT_CLASSIC_ENABLED=y
# CONFIG_BT_HID_HOST_ENABLED=y

# wifi (disabled for smoke test, enable later)
# CONFIG_ESP_WIFI_SOFTAP_ENABLED=y
```
